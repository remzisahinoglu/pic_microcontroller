;***********MOTOR PWM KONTROL**************************
	LIST		P=16F876A
	INCLUDE		"P16F876A.INC"
	__CONFIG(_CP_OFF & _PWRTE_OFF & _HS_OSC & _WDT_OFF & _BODEN_OFF & _LVP_OFF)

		ERRORLEVEL	-302
		ERRORLEVEL	-306

		CBLOCK	H'20'
		W_SAVE,S_SAVE,P_SAVE
		PWMX1A,PWMX1DEGER,PWMREG,PWMSTATUS
		REG1,REG2,REG1X,REG2X,REG3X,REG4X,POT1,FLAG
		ENDC





#DEFINE		INTPERYOD	PORTC,4
#DEFINE		PWMKEY1		PWMREG,0
#DEFINE		PWM1		PWMSTATUS,0
#DEFINE		PWMOUT1		PORTB,7

#DEFINE		MOTORON		PORTC,5
#DEFINE		MOTORYON	PORTC,6
#DEFINE		YONA		PORTB,5
#DEFINE		YONB		PORTB,6
#DEFINE		YONLEDSAG	PORTB,2
#DEFINE		YONLEDSOL	PORTC,7


TIMERX		EQU		.160
CUTOFF		EQU		.30
POT_OFFSET	EQU		.25
SAYIMZAMAN	EQU		.250	


		ORG		0X000
		GOTO		SETUP
		ORG		0X004
		GOTO		INTER
		RETFIE

INTER
		MOVWF		W_SAVE	
		MOVF		STATUS,W
		MOVWF		S_SAVE
		MOVF		PCLATH,W
		MOVWF		P_SAVE
		BTFSC		INTCON,T0IF
		CALL		PWMLOAD
INTEROF
		MOVF		P_SAVE,W
		MOVWF		PCLATH
		MOVF		S_SAVE,W
		MOVWF		STATUS
		SWAPF		W_SAVE,F
		SWAPF		W_SAVE,W
		RETFIE 


START
		MOVLW		B'10100000'
		MOVWF		INTCON		
		MOVLW		TIMERX
		MOVWF		TMR0



MAIN
		BSF			T1CON,TMR1ON
		CALL		YON
		GOTO		MAIN

YON
		BTFSS		MOTORON
		BCF			PWMKEY1
		BTFSC		MOTORON
		BSF			PWMKEY1

		BTFSS		PWMKEY1
		BCF			INTPERYOD
		BTFSC		PWMKEY1
		BSF			INTPERYOD

		BTFSS		MOTORYON
		BSF			YONA
		BTFSS		MOTORYON
		BCF			YONB
		BTFSC		MOTORYON
		BCF			YONA
		BTFSC		MOTORYON
		BSF			YONB


		BTFSS		MOTORYON
		BSF			YONLEDSAG
		BTFSS		MOTORYON
		BCF			YONLEDSOL
		BTFSC		MOTORYON
		BCF			YONLEDSAG
		BTFSC		MOTORYON
		BSF			YONLEDSOL

		BTFSS		PWMKEY1
		CALL		AC10
		RETURN
PWMLOAD
		CALL		ANALOG1
		BCF			INTCON,T0IF
		MOVLW		TIMERX
		MOVWF		TMR0
		BTFSC		PWMKEY1
		CALL		PWMM1
		RETURN
PWMM1
		DECFSZ		PWMX1DEGER,F
		RETURN
		BTFSS		PWM1
		GOTO		AC11
		BTFSC		PWM1
		GOTO		AC10
		RETURN
AC11
		BSF			PWMOUT1
		MOVF		PWMX1A,W
		MOVWF		PWMX1DEGER
		BSF			PWMSTATUS,0
		RETURN
AC10
		BCF			PWMOUT1
		MOVF		PWMX1A,W
		SUBLW		.255
		MOVWF		PWMX1DEGER
		BCF			PWMSTATUS,0
		RETURN	
WAIT
		MOVLW		.50
		MOVWF		REG1
		DECFSZ		REG1,F
		GOTO		$ - 1
		RETURN
BEKLE
		MOVLW		.9
		MOVWF		REG4X
		CALL		MS_100
		DECFSZ		REG4X,F
		GOTO		$ - 2
		RETURN
MS_100
		MOVLW		0X03
		MOVWF		REG3X
MMS
		MOVLW		0XA3
		MOVWF		REG1X
MM		MOVLW		0X3D
		MOVWF		REG2X
		DECFSZ		REG2,F
		GOTO		$ - 1
		DECFSZ		REG1X,F		
		GOTO		MM
		DECFSZ		REG3X,F		
		GOTO		MMS
		RETURN
ANALOG1
		MOVLW		B'11000001'		;RA0
		MOVWF		ADCON0
		CALL		WAIT
		BSF			ADCON0,GO 
		BCF			PIR1,ADIF 
		BTFSS		PIR1,ADIF 
		GOTO		$-1 
		MOVLW		POT_OFFSET
		ADDWF		ADRESH,F
		MOVF		ADRESH,W

		MOVWF		POT1
		MOVWF		PWMX1A

		SUBLW		CUTOFF
		BTFSS		STATUS,C
		GOTO		SEC2

		MOVLW		.1
		MOVWF		POT1
		MOVWF		PWMX1A
		RETURN
SEC2
		MOVLW		.250
		SUBWF		ADRESH,W
		BTFSS		STATUS,C
		RETURN
		MOVLW		.250
		MOVWF		POT1
		MOVWF		PWMX1A
		RETURN


SETUP
		MOVLW		H'FF'
		MOVWF		PWMSTATUS
		CLRF		PORTA
		CLRF		PORTB

		BSF			STATUS,5

		MOVLW		B'00011011'
		MOVWF		TRISB
		MOVLW		B'01101111'
		MOVWF		TRISC
		MOVLW		B'00110100'
		MOVWF		ADCON1
		MOVLW		B'00000010'
		MOVWF		OPTION_REG

		BCF			STATUS,5
		BSF			T1CON,TMR1CS
		MOVLW		SAYIMZAMAN
		GOTO		START

		END













